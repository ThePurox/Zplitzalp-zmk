## boards/shields/zplitzalp/Kconfig.defconfig
```kconfig
if SHIELD_ZPLITZALP_LEFT

# Name must be less than 16 characters long!
config ZMK_KEYBOARD_NAME
    default "Zplit Zalp"

config ZMK_SPLIT_ROLE_CENTRAL
    default y

endif

if SHIELD_ZPLITZALP_LEFT || SHIELD_ZPLITZALP_RIGHT

config ZMK_SPLIT
    default y

endif
```

## boards/shields/zplitzalp/Kconfig.shield
```kconfig
# No whitespace after the comma or in your part name!
config SHIELD_ZPLITZALP_LEFT
    def_bool $(shields_list_contains,zplitzalp_left)

# No whitespace after the comma or in your part name!
config SHIELD_ZPLITZALP_RIGHT
    def_bool $(shields_list_contains,zplitzalp_right)
```
